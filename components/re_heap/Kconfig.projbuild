## components/re_heap/Kconfig.projbuild
```kconfig
menu "K12 options"

	menu "Heap allocations"
	
	    config HEAP_ALLOC_FAILED_RETRY
	        int "Number of memory allocation retries"
	        default 0
	        help
				If the memory allocation fails, several more retries will be made with a 
				slight delay. Set to 0 to disable this feature
	
	    config HEAP_ALLOC_FAILED_RETRY_DELAY
	        int "Delay between retries of memory allocation"
	        default 1000
	        help
				Delay between retries of memory allocation in milliseconds

	endmenu

endmenu
```
